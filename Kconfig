## Kconfig
```kconfig
mainmenu "C/CPP CMake project framework Kconfig configuration"

menu "Toolchain configuration"
	config TOOLCHAIN_PATH
		string "toolchain path"
		default "/opt/kendryte-toolchain/bin"
	
	config TOOLCHAIN_PREFIX
		string "toolchain prefix"
		default "riscv64-unknown-elf-"
endmenu

menu "Components configuration"
	osource "${SDK_PATH}/components/*/Kconfig"
	osource "${PROJECT_PATH}/*/Kconfig"
endmenu

menu "Others"
	config LIB_NNCASE_SOURCE_CODE_ENABLE
		bool "compile nncase source code"
		default n
endmenu
```

## components/boards/Kconfig
```kconfig
menu "Board config"

	choice BOARD
		bool "Select board"
		default BOARD_MAIX
		config BOARD_MAIX
			bool "Select board Maix"

		config BOARD_M5STICK
			bool "Select board m5stick"
		config BOARD_TWATCH
			bool "Select board TWatch"
	endchoice

	config LCD_DEFAULT_WIDTH
		int "LCD default width"
		default 320
	
	config LCD_DEFAULT_HEIGHT
		int "LCD default height"
		default 240

	config LCD_DEFAULT_FREQ
		int "LCD default driver clock frequency"
		default 15000000

	config SENSOR_FREQ
		int "Sensor clock(xclk) frequency"
		default 24000000
	config CPU_DEFAULT_FREQ
		int "CPU clock default frequency, can be overwrite by config file in file system"
		default 400000000
endmenu
```

## components/drivers/Kconfig
```kconfig
config COMPONENT_DRIVERS_ENABLE
	bool "Enable drivers component"
	default n
	select COMPONENT_KENDRYTE_SDK_ENABLE

menu "Drivers configuration"
	depends on COMPONENT_DRIVERS_ENABLE

	menu "SD card"
		config SPI_SD_CARD_FORCE_HIGH_SPEED
			bool "Force SPI SD card high speed mode"
			default y
	endmenu

	menu "WS2812"
		config WS2812_ENABLE
			bool "Enable ws2812 over i2s component"
			default n
	endmenu
	menu "HTPA thermal sensor"
		config HTPA_ENABLE
			bool "Enable HTPA thermal sensor"
			default n
	endmenu
	menu "AMG88XX thermal sensor"
		config AMG88XX_ENABLE
			bool "Enable AMG88XX thermal sensor"
			default n
	endmenu
endmenu
```

## components/kendryte_sdk/Kconfig
```kconfig
config COMPONENT_KENDRYTE_SDK_ENABLE
	bool "Enable kendryte sdk component"
	default y
menu "Kendryte SDK configurations"
	depends on COMPONENT_KENDRYTE_SDK_ENABLE
	config SDK_LOG_LEVEL
		int "log level, 5:LOG_VERBOSE, 4:LOG_DEBUG, 3:LOG_INFO, 2:LOG_WARN, 1:LOG_ERROR, 0:LOG_NONE"
		range 0 5
		default 5
	config SDK_LOCK_NUM
		int "SDK LOCK number, one lock need 24B"
		default 64
	config FREERTOS_ENABLE
		bool "Enable FreeRTOS"
		default y
	menu "FreeRTOS configurations"
		depends on FREERTOS_ENABLE
		config STATIC_TASK_CLEAN_UP_ENABLE
			bool "static task clean up callback"
			default n
		config FREERTOS_MALLOC_CUSTOM
			bool "Use custom malloc method(heap_4.c) instead of libc's(stdlib.h)"
			default n
		config FREERTOS_HEAP_TOTAL_SIZE
			depends on FREERTOS_MALLOC_CUSTOM
			int "FreeRTOS heap total size"
			default 524288
		config FREEROTS_MINIMUM_STACK_SIZE
			int "FreeRTOS minimum stack size"
			default 2048
	endmenu
	config MIC_ARRAY_ENABLE
		bool " Enable mic array module"
		default n
endmenu
```

## components/micropython/Kconfig
```kconfig
config COMPONENT_MICROPYTHON_ENABLE
	bool "Enbale micropython component"
	default n
	select COMPONENT_KENDRYTE_SDK_ENABLE
	select COMPONENT_DRIVERS_ENABLE
	select COMPONENT_SPIFFS_ENABLE
	select COMPONENT_UTILS_ENABLE

menu "Micropython configurations"
	depends on COMPONENT_MICROPYTHON_ENABLE
	config MAIXPY_GC_HEAP_SIZE
		hex "GC heap size, hex format, MUST be aligned 8 Bytes, default 512kB(0x80000)"
		default 0x80000
	menu "Modules configurations"

		config MAIXPY_IDE_SUPPORT
			bool "Enable MaixPy IDE protocol support"
			default y

		config MAIXPY_THREAD_ENABLE
			bool "Enable _thread module"
			default y
			select FREERTOS_ENABLE
			select STATIC_TASK_CLEAN_UP_ENABLE

		config MAIXPY_NES_ENABLE
			bool "Enable NES emulator"
			default y

		config MAIXPY_AUDIO_ENABLE
			bool "Enable audio module"
			default y

		config MAIXPY_VIDEO_ENABLE
			bool "Enable video module"
			default y

		config MAIXPY_SPEECH_MODULE
			bool "Enable speech module"
			default y

		config MAIXPY_TOUCH_SCREEN_ENABLE
			bool "Enable touch screen module"
			default y

		choice MAIXPY_TOUCH_SCREEN_DRIVER
			bool "Select touch screen driver"
			default MAIXPY_TOUCH_SCREEN_DRIVER_NS2009
			depends on MAIXPY_TOUCH_SCREEN_ENABLE
			config MAIXPY_TOUCH_SCREEN_DRIVER_NS2009
				bool "Select ns2009 touch screen driver"
			config MAIXPY_TOUCH_SCREEN_DRIVER_FT52XX
				bool "Select ft52xx touch screen driver"
		endchoice

		config MAIXPY_OMV_MINIMUM
			bool "Minimum size OMV function (just disable omv advanced functions )"
			default n

		config MAIXPY_OMV_CONV_YUV_FAST
			bool "Add YUV convert table, speed up convert but more code"
			default n

		config MAIXPY_OMV_DOUBLE_BUFF
			bool "Set double buffer for sensor(camera)"
			default y

		config MAIXPY_MIC_ARRAY_ENABLE
			select MIC_ARRAY_ENABLE
			bool "Enable Maix.MIC_ARRAY module"
			default y

		config MAIXPY_LVGL_ENABLE
			bool "Enbale LittlvGL"
			default n
			select MAIXPY_LODEPNG_ENABLE

		config MAIXPY_LODEPNG_ENABLE
			bool "Enable lodepng module"
			default n

		config MAIXPY_OMV_BINARY_OPS
			bool "Enable binary operations in OMV"
			default n

		config MAIXPY_OMV_MATH_OPS
			bool "Enable math operations in OMV"
			default n

		config MAIXPY_OMV_MEDIAN
			bool "Enable median() in OMV"
			default n

		config MAIXPY_OMV_QRCODES
			bool "Enable find_qrcodes() in OMV"
			default n

		config MAIXPY_WS2812_ENABLE
			bool "Enable Ws2812"
			default n
			select WS2812_ENABLE

		config MAIXPY_HTPA_ENABLE
			bool "Enable HTPA thermal sensor"
			default n
			select HTPA_ENABLE

		config MAIXPY_AMG88XX_ENABLE
			bool "Enable AMG88XX thermal sensor"
			default n
			select AMG88XX_ENABLE

		config MAIXPY_ULTRASONIC_ENABLE
			bool "Enable ultrasonic"
			default n

		config MAIXPY_ONEWIRE_ENABLE
			bool "Enable onewire"
			default n

		config MAIXPY_NETWORK_ENABLE
			bool "Enable networking"
			default y

		config MICROPYTHON_PY_URE_ENABLE
			bool "Enable re"
			default y

		config MICROPYTHON_ULAB_ENALBE
			bool "Enable ulab module(a numpy-like fast vector module)"
			default y

		config MICROPYTHON_KMODEL_V4_SUPPORT
			bool "support v4 kmodel"
			default n

		config MAIXPY_SPEECH_RECOGNIZER_ENABLE
			bool "Enable Speech Recognizer"
			default n
			select SPEECH_RECOGNIZER_ENABLE
			
		config MICROPY_SSL_ENABLE
			bool "Enable Https SSL"
			default n

		config MAIXPY_WIZNET5K_ENABLE
			bool "Enable WIZNET5K"
			default n
			select WIZNET5K_ENABLE

		config MAIXPY_FLASH_ENABLE
			bool "Enable flash module"
			default n

		config MAIXPY_HASHLIB_ENABLE
			bool "Enable hashlib module"
			default y

		config MAIXPY_BTC_HASHLIB_ENABLE
			bool "Enable bitcoin-specific hashlib module"
			default n

		config MAIXPY_QRCODE_ENABLE
			bool "Enable qrcode module"
			default n

		config MAIXPY_SECP256K1_ENABLE
			bool "Enable secp256k1-embedded module"
			default n

		config MAIXPY_SHANNON_ENABLE
			bool "Enable shannon module"
			default n

		config MAIXPY_USE_MEMZIP
			bool "Use memzip instead of frozen mpy"
			default n
	endmenu

	menu "Builtin py modules configurations"

		config MAIXPY_BUILTIN_PY_PYE
			bool "Enable builtin py module pye (about 17KiB)"
			default y
		config MAIXPY_BUILTIN_PY_BOARD
			bool "Enable builtin py module board"
			default y
		config MAIXPY_BUILTIN_PY_FPIOA_MANAGER
			bool "Enable builtin py module fpioa_manager"
			default y
	endmenu

	menu "Debug configurations"
		config MAIXPY_K210_UARTHS_DEBUG
			bool "Use UARTHS to debug(pin9, pin10), UART2 to REPL(pin4, pin5)"
			default n

		config MAIXPY_LVGL_DEBUG
			depends on MAIXPY_LVGL_ENABLE
			bool "Enable LVGL debug info logging"
			default y

		config MAIXPY_LVGL_DEBUG_LEVEL
			depends on MAIXPY_LVGL_DEBUG
			int "LVGL debug level:[0,3]( [TRACE, INFO, WARN, ERROR])"
			default 2
	endmenu

	config BUILTIN_PY_DIR
		string "builtin py directory"
		default ""
endmenu

menu "Others"
	depends on COMPONENT_MICROPYTHON_ENABLE
	config COMPONENT_LIB_SIPEED_KPU_SRC_ENABLE
		bool "Compile lib_sipeed_kpu source code"
		default n
endmenu
```

## components/spiffs/Kconfig
```kconfig
config COMPONENT_SPIFFS_ENABLE
	bool "Enable spiffs component"
	default n
menu "SPIFFS Configuration"
	depends on COMPONENT_SPIFFS_ENABLE

	menu "SPIFFS Cache Configuration"
        config SPIFFS_CACHE
            bool "Enable SPIFFS Cache"
            default "y"
            help
                Enables/disable memory read caching of nucleus file system
                operations.

        config SPIFFS_CACHE_WR
            bool "Enable SPIFFS Write Caching"
            default "y"
            depends on SPIFFS_CACHE
            help
                Enables memory write caching for file descriptors in hydrogen.

        config SPIFFS_CACHE_STATS
            bool "Enable SPIFFS Cache Statistics"
            default "n"
            depends on SPIFFS_CACHE
            help
                Enable/disable statistics on caching. Debug/test purpose only.
    endmenu

	config SPIFFS_SIZE
		hex "SPIFFS size"
		default 0x300000

	config SPIFFS_START_ADDR
		hex "Start address of SPIFFS"
		default 0xD00000
		help
			must be on block boundary

	config SPIFFS_EREASE_SIZE
		hex "Erease size of SPIFFS, see the datasheet"
		default 0x1000
	
	config SPIFFS_LOGICAL_BLOCK_SIZE
		hex "Logical block size of SPIFFS(default 32*4k)"
		default 0x20000
		help
			logical size of a block, must be on physical block size boundary
			and must never be less than a physical block

	config SPIFFS_LOGICAL_PAGE_SIZE
		hex "Logical page size of SPIFFS(default 4k(SPIFFS_LOGICAL_BLOCK_SIZE/32))"
		default 0x1000
		help
			logical size of a page, must be at least logical block size / 8

	config SPIFFS_OBJ_NAME_LEN
        int "Set SPIFFS Maximum Name Length"
        default 128
        range 1 256
    
        config SPIFFS_USE_MAGIC
        bool "Enable SPIFFS Filesystem Magic"
        default "y"
        help
            Enable this to have an identifiable spiffs filesystem.
            This will look for a magic in all sectors to determine if this
            is a valid spiffs system or not at mount time.

    config SPIFFS_USE_MAGIC_LENGTH
        bool "Enable SPIFFS Filesystem Length Magic"
        default "y"
        depends on SPIFFS_USE_MAGIC
        help
            If this option is enabled, the magic will also be dependent
            on the length of the filesystem. For example, a filesystem
            configured and formatted for 4 megabytes will not be accepted
            for mounting with a configuration defining the filesystem as 2 megabytes.

    config SPIFFS_META_LENGTH
        int "Size of per-file metadata field"
        default 0
        help
            This option sets the number of extra bytes stored in the file header.
            These bytes can be used in an application-specific manner.
            Set this to at least 4 bytes to enable support for saving file
            modification time.

            SPIFFS_OBJ_NAME_LEN + SPIFFS_META_LENGTH should not exceed
            SPIFFS_PAGE_SIZE - 64.
	
	menu "Debug Configuration"

        config SPIFFS_DBG
            bool "Enable general SPIFFS debug"
            default "n"
            help
                Enabling this option will print general debug mesages to the console.

        config SPIFFS_API_DBG
            bool "Enable SPIFFS API debug"
            default "n"
            help
                Enabling this option will print API debug mesages to the console.

        config SPIFFS_GC_DBG
            bool "Enable SPIFFS Garbage Cleaner debug"
            default "n"
            help
                Enabling this option will print GC debug mesages to the console.

        config SPIFFS_CACHE_DBG
            bool "Enable SPIFFS Cache debug"
            default "n"
            depends on SPIFFS_CACHE
            help
                Enabling this option will print cache debug mesages to the console.

        config SPIFFS_CHECK_DBG
            bool "Enable SPIFFS Filesystem Check debug"
            default "n"
            help
                Enabling this option will print Filesystem Check debug mesages
                to the console.
    endmenu
	
endmenu
```

## projects/mmu_code/Kconfig
```kconfig
config FIRMWARE_FLASH_ADDR
	hex "Where firmware load from flash(section .text_flash) burn to"
	default 0x200000
```
